## boards/shields/soflecustom~/Kconfig.shield
```kconfig
config SHIELD_SOFLECUSTOM_LEFT
    def_bool $(shields_list_contains,soflecustom_left)

config SHIELD_SOFLECUSTOM_RIGHT
    def_bool $(shields_list_contains,soflecustom_right)
```

## config/boards/shields/soflecustom~/Kconfig.defconfig
```kconfig
if SHIELD_SOFLECUSTOM_LEFT

config ZMK_KEYBOARD_NAME
	default "Sofle"

config ZMK_SPLIT_ROLE_CENTRAL
	default y

endif

if SHIELD_SOFLECUSTOM_LEFT || SHIELD_SOFLECUSTOM_RIGHT

config ZMK_POINTING
    default y

config ZMK_SPLIT
	default y

config ZMK_SLEEP
	default y

config CONFIG_ZMK_PM_SOFT_OFF
	default y

endif
```
